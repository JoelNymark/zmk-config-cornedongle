## config/boards/shields/cornedongle/Kconfig.defconfig
```kconfig
if shield_corne_dongle

config ZMK_KEYBOARD_NAME
    default "Dongle"

CONFIG_ZMK_BLE_CENTRAL=y
CONFIG_ZMK_USB=y


endif
```

## config/boards/shields/cornedongle/Kconfig.shield
```kconfig
config shield_corne_left
    def_bool $(shield_list_contains, corne_left)
config shield_corne_right
    def_bool $(shield_list_contains, corne_right)
config shield_cornedongle
    def_bool $(shield_list_contains, corne_dongle)
```
